## package/util-linux-dmesg/Config.in
```kconfig
config BR2_PACKAGE_UTIL_LINUX_DMESG
	bool "util-linux-dmesg"
	depends on !BR2_PACKAGE_UTIL_LINUX_BINARIES
	help
	  The dmesg utility from util-linux.
```
